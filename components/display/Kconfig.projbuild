## components/display/Kconfig.projbuild
```kconfig
menu "UC display state machine preferences"

	config UCD_UISM_BOOTUP_TIMEOUT_SEC
		int "Bootup timer animation timeout in sec"
		range 0 60
		default 3

	config UCD_UISM_RUNNING_TIMEOUT_SEC
		int "Running timer timeout in sec"
		range 1 60
		default 4

	config UCD_UISM_OTA_TIMEOUT_SEC
		int "OTA timer timeout in sec"
		range 1 60
		default 20

	config UCD_UISM_IRLEARN_TIMEOUT_SEC
		int "IR learning timer timeout in sec"
		range 1 180
		default 60

	config UCD_UISM_IMPROV_TIMEOUT_SEC
		int "Improv-wifi timer timeout in sec"
		range 1 180
		default 60

	config UCD_UISM_FACTORY_RESET_TIMOUT_SEC
		int "Factory reset countdown in sec"
		range 1 20
		default 8
	
endmenu
```

## components/led/Kconfig.projbuild
```kconfig
menu "LED pattern configuration"
	config GPIO_LED_RANGE_MAX
		int
		default 33 if IDF_TARGET_ESP32
		default 46 if IDF_TARGET_ESP32S2
		default 48 if IDF_TARGET_ESP32S3
		default 18 if IDF_TARGET_ESP32C2
		default 19 if IDF_TARGET_ESP32C3
		default 30 if IDF_TARGET_ESP32C6

	choice LED_PATTERN
		prompt "Choose LED identification option"
		default LED_PATTERN_GPIO
		help
			Select identify method:
			- GPIO LED: simple LED on a GPIO output
			- PWN LED: Use LEDC to control a LED. Supports brightness.
			- PWN RGB LED: Use LEDC to control an RGB LED. Supports brightness and color.
			- WS2812 LED strip: Espressif led_strip component using SPI or an RMT channel
		config LED_PATTERN_NONE
			bool "Disabled"
		config LED_PATTERN_GPIO
			bool "GPIO LED"
			help
				Set a GPIO to low / high to turn on a LED.
		config LED_PATTERN_PWN
			bool "PWN LED"
			help
				Use LEDC to control a LED. Supports brightness.
		config LED_PATTERN_RGB
			bool "PWN RGB LED"
			help
				Use LEDC to control an RGB LED. Supports brightness and color.
		config LED_PATTERN_STRIP
			bool "WS2812 LED strip using SPI or RMT"
			help
				Use led_strip for notification. Supports brightness, color and multiple LEDs.
	endchoice

	menu "GPIO LED"
		visible if LED_PATTERN_GPIO

		config LED_PATTERN_GPIO_NUM
			depends on LED_PATTERN_GPIO
			int "Identify LED GPIO number"
			range 0 GPIO_LED_RANGE_MAX
			default 21 if IDF_TARGET_ESP32
			default 11 if IDF_TARGET_ESP32S2
			default 11 if IDF_TARGET_ESP32S3
			default  5 # C3 and others
			help
				GPIO number (IOxx) to use for LED identification.

		config LED_PATTERN_ACTIVE_LEVEL
			depends on LED_PATTERN_GPIO
			bool "GPIO active level"
			default y
			help
				GPIO active level.
	endmenu

	menu "PWN LED"
		visible if LED_PATTERN_PWN

		config LED_PATTERN_PWN_GPIO
			depends on LED_PATTERN_PWN
			int "Identify PWN LED GPIO number"
			range 0 GPIO_LED_RANGE_MAX
			default 21 if IDF_TARGET_ESP32
			default 11 if IDF_TARGET_ESP32S2
			default 11 if IDF_TARGET_ESP32S3
			default  5 # C3 and others
			help
				GPIO number (IOxx) to use for LED identification.

		config LED_PATTERN_PWN_CHANNEL
			depends on LED_PATTERN_PWN
			int "LED channel"
			default 0
			help
				LED channel to use for example.
	
		config LED_PATTERN_PWN_ACTIVE_LEVEL
			depends on LED_PATTERN_PWN
			bool "GPIO active level"
			default y
			help
				GPIO active level.
	endmenu

	menu "RGB LED"
		visible if LED_PATTERN_RGB

		config LED_PATTERN_RED_GPIO
			depends on LED_PATTERN_RGB
			int "Identify RGB LED GPIO red number"
			range 0 GPIO_LED_RANGE_MAX
			default 25 if IDF_TARGET_ESP32
			default 1
			help
				GPIO number (IOxx) to use for red LED identification.

		config LED_PATTERN_GREEN_GPIO
			depends on LED_PATTERN_RGB
			int "Identify RGB LED GPIO green number"
			range 0 GPIO_LED_RANGE_MAX
			default 26 if IDF_TARGET_ESP32
			default 2
			help
				GPIO number (IOxx) to use for green LED identification.

		config LED_PATTERN_BLUE_GPIO
			depends on LED_PATTERN_RGB
			int "Identify RGB LED GPIO blue number"
			range 0 GPIO_LED_RANGE_MAX
			default 27 if IDF_TARGET_ESP32
			default 3
			help
				GPIO number (IOxx) to use for blue LED identification.
	
		config LED_PATTERN_RED_CHANNEL
			depends on LED_PATTERN_RGB
			int "LED red channel"
			default 0
			help
				LED channel to use for red.

		config LED_PATTERN_GREEN_CHANNEL
			depends on LED_PATTERN_RGB
			int "LED green channel"
			default 1
			help
				LED channel to use for green.

		config LED_PATTERN_BLUE_CHANNEL
			depends on LED_PATTERN_RGB
			int "LED blue channel"
			default 2
			help
				LED channel to use for blue.
							
		config LED_PATTERN_RGB_ACTIVE_LEVEL
			depends on LED_PATTERN_RGB
			bool "GPIO active level"
			default n
			help
				GPIO active level.
	endmenu

	menu "WS2812 LED strip"
		visible if LED_PATTERN_STRIP

		config LED_PATTERN_STRIP_GPIO
			depends on LED_PATTERN_STRIP
			int "LED strip data line GPIO"
			range 0 GPIO_LED_RANGE_MAX
			default 23
			help
				GPIO number (IOxx) to use for LED strip data line.

		config LED_PATTERN_STRIP_RMT
			depends on LED_PATTERN_STRIP
			bool "Use RMT"
			default n
			help
				Whether to use an RMT channel instead of SPI

		
		config LED_PATTERN_STRIP_NUMBER
			depends on LED_PATTERN_STRIP
			int "Number of LEDs"
			range 1 100
			default 1
			help
				The number of LEDs in the strip.

		choice LED_PATTERN_STRIP_PIXEL_FORMAT
			prompt "Pixel format"
			default LED_PATTERN_STRIP_PIXEL_FORMAT_GRB
			help
				Select the pixel format of the LED strip.
				GRB is mostly used for surface mounted LEDs.
			config LED_PATTERN_STRIP_PIXEL_FORMAT_GRB
				bool "GRB"
			config LED_PATTERN_STRIP_PIXEL_FORMAT_GRBW
				bool "GRBW"
		endchoice

		config LED_PATTERN_STRIP_PIXEL_FORMAT
			int
			default 0 if LED_PATTERN_STRIP_PIXEL_FORMAT_GRB
			default 1 if LED_PATTERN_STRIP_PIXEL_FORMAT_GRBW

		config LED_PATTERN_STRIP_RESOLUTION
			depends on LED_PATTERN_STRIP
			int "RMT tick resolution"
			default 10000000
			help
				RMT tick resolution, if set to zero, a default resolution (10MHz) will be applied
	
		config LED_PATTERN_STRIP_INVERT
			depends on LED_PATTERN_STRIP
			bool "Invert output signal"
			default y
			help
				Whether to invert the output signal

		config LED_PATTERN_STRIP_DMA
			depends on LED_PATTERN_STRIP
			bool "Use DMA feature"
			default n
			help
				DMA feature is available on ESP target like ESP32-S3

	endmenu

endmenu
```

## components/network/Kconfig.projbuild
```kconfig
menu "UC Dock Network Configuration"

	orsource "$IDF_PATH/examples/common_components/env_caps/$IDF_TARGET/Kconfig.env_caps"

	choice UCD_ETHERNET_TYPE_SPI
		prompt "Ethernet SPI"
		default UCD_USE_KSZ8851SNL
		help
			Select which kind of Ethernet will be used in the example.

		config UCD_USE_DM9051
			bool "DM9051 Module"
			select ETH_SPI_ETHERNET_DM9051
			help
				Select external SPI-Ethernet module (DM9051).

		config UCD_USE_KSZ8851SNL
			bool "KSZ8851SNL Module"
			select ETH_SPI_ETHERNET_KSZ8851SNL
			help
				Select external SPI-Ethernet module (KSZ8851SNL).

		config UCD_USE_W5500
			bool "W5500 Module"
			select ETH_SPI_ETHERNET_W5500
			help
				Select external SPI-Ethernet module (W5500).
	endchoice

	config UCD_ETH_SPI_HOST
		int "SPI Host Number"
		range 0 2
		default 1
		help
			Set the SPI host used to communicate with the SPI Ethernet Controller.

	config UCD_ETH_SPI_SCLK_GPIO
		int "SPI SCLK GPIO number"
		range ENV_GPIO_RANGE_MIN ENV_GPIO_OUT_RANGE_MAX
		default 12
		help
			Set the GPIO number used by SPI SCLK.

	config UCD_ETH_SPI_MOSI_GPIO
		int "SPI MOSI GPIO number"
		range ENV_GPIO_RANGE_MIN ENV_GPIO_OUT_RANGE_MAX
		default 11
		help
			Set the GPIO number used by SPI MOSI.

	config UCD_ETH_SPI_MISO_GPIO
		int "SPI MISO GPIO number"
		range ENV_GPIO_RANGE_MIN ENV_GPIO_IN_RANGE_MAX
		default 13
		help
			Set the GPIO number used by SPI MISO.

	config UCD_ETH_SPI_CLOCK_MHZ
		int "SPI clock speed (MHz)"
		range 5 80
		default 50
		help
			Set the clock speed (MHz) of SPI interface.

	config UCD_ETH_SPI_CS0_GPIO
		int "SPI CS0 GPIO number for SPI Ethernet module"
		range ENV_GPIO_RANGE_MIN ENV_GPIO_OUT_RANGE_MAX
		default 6
		help
			Set the GPIO number used by SPI CS0, i.e. Chip Select associated with the first SPI Eth module.

	config UCD_ETH_SPI_INT0_GPIO
		int "Interrupt GPIO number SPI Ethernet module"
		range -1 ENV_GPIO_IN_RANGE_MAX
		default 46
		help
			Set the GPIO number used by the first SPI Ethernet module interrupt line.
			Set -1 to use SPI Ethernet module in polling mode.

	config UCD_ETH_SPI_POLLING0_MS_VAL
		depends on UCD_ETH_SPI_INT0_GPIO < 0
		int "Polling period in msec of SPI Ethernet Module"
		default 10
		help
			Set SPI Ethernet module polling period.

	# Hidden variable to ensure that polling period option is visible only when interrupt is set disabled and
	# it is set to known value (0) when interrupt is enabled at the same time.
	config UCD_ETH_SPI_POLLING0_MS
		int
		default UCD_ETH_SPI_POLLING0_MS_VAL if UCD_ETH_SPI_POLLING0_MS_VAL > 0
		default 0

	config UCD_ETH_SPI_PHY_RST0_GPIO
		int "PHY Reset GPIO number of SPI Ethernet Module"
		range -1 ENV_GPIO_OUT_RANGE_MAX
		default -1
		help
			Set the GPIO number used to reset PHY chip on the first SPI Ethernet module.
			Set to -1 to disable PHY chip hardware reset.

	config UCD_ETH_SPI_PHY_ADDR0
		int "PHY Address of SPI Ethernet Module"
		range 0 31
		default 1
		help
			Set the first SPI Ethernet module PHY address according your board schematic.

	config NETWORK_MANAGER_TASK_PRIORITY
		int "RTOS task priority for the network manager"
		default 5
		help
		Tasks spawn by the manager will have a priority of NETWORK_MANAGER_TASK_PRIORITY-1. For this particular reason, minimum recommended task priority is 2.

	config NETWORK_MANAGER_MAX_RETRY
		int "Max retry for failed WiFi connections"
		default 10
		help
		Number of retries for a failed WiFi connection, or if the connection is lost, before giving up.

	config NETWORK_MANAGER_ETH_LINK_UP_TIMEOUT
		int "Ethernet link up timeout in seconds"
		default 6
		help
		Timeout for ethernet link up after driver initialization.
	
	config NETWORK_MANAGER_ETH_LINK_DOWN_REBOOT_TIMEOUT
		int "Ethernet link down reboot timeout in seconds"
		default 30
		help
		Reboot device if ethernet is down for that many seconds without having a wifi configuration.
	
	config NETWORK_MANAGER_DHCP_TIMEOUT
		int "DHCP timeout in seconds"
		default 15
		help
		Timeout to get an IP assignement from the DHCP server.

	config NETWORK_MANAGER_STA_POLLING_MIN
		int "Min WIFI STA polling in seconds"
		default 1
		help
		Minimal retry interval in seconds to connect to an access point. The backoff factor is applied to further retries.

	config NETWORK_MANAGER_STA_POLLING_MAX
		int "Max WIFI STA polling in seconds"
		default 30
		help
		Maximum retry interval in seconds to connect to an access point.

	config NETWORK_MANAGER_RETRY_BACKOFF
		int "Connection retry backoff factor in %"
		default 150
		help
		Retry attemps will start with a delay of NETWORK_MANAGER_STA_POLLING_MIN.
		Each further retry attempt is delayed with the backoff factor.
		A value of 150 means 150% longer than the last one. For example: if the last duration was 10s, the next will be 15s.

	config NETWORK_MANAGER_WIFI_CONNECTED_TIMEOUT
		int "WIFI connected timeout in seconds"
		default 15
		help
		Safeguard timeout for WIFI connections if neither a CONNECTED or CONNECTION_LOST event is received.
	
	config IMPROV_WIFI_CAPABILITY_IDENTIFY
		bool "Device supports the identify command"
		default n

	config IMPROV_WIFI_AUTHENTICATION_BUTTON
		bool "Device supports authentication button"
		default n
		help
			Use a GPIO button for authentication.

	config IMPROV_WIFI_PROVISIONED_URL
		string "Redirect URL after successful provisioning"
		default "https://www.unfoldedcircle.com/"
		help
			The URL to return after a successfull provisioning.

	menu "improv-wifi authorization configuration"
		visible if IMPROV_WIFI_AUTHENTICATION_BUTTON

		config IMPROV_WIFI_BUTTON_GPIO
			depends on IMPROV_WIFI_AUTHENTICATION_BUTTON
			int "Authentication button GPIO number"
			range 0 GPIO_RANGE_MAX
			default  9 if IDF_TARGET_ESP32C6
			default  0
			help
				GPIO number (IOxx) to use for the authentication button.
				Use the "Component config, IoT Button" settings to configure button press timings.

		config IMPROV_WIFI_AUTHENTICATION_TIMEOUT
			depends on IMPROV_WIFI_AUTHENTICATION_BUTTON
			int "Authorization timeout in seconds"
			range 1 1000
			default 60
			help
				If an Improv service has been authorized by a user interaction,
				the authorization should be automatically revoked after a timeout.

	endmenu
		
endmenu
```

## components/preferences/Kconfig.projbuild
```kconfig
menu "UC Dock preferences"

	choice UCD_HW_REVISION
		prompt "Choose hardware model"
		default UCD_HW_REVISION_4
		help
			Select the hardware board revision
		config UCD_HW_REVISION_3
			bool "Test revision 3"
		config UCD_HW_REVISION_4
			bool "Production revision 4"
	endchoice

endmenu
```

## components/webserver/Kconfig.projbuild
```kconfig
menu "UC Dock webserver"

	config UCD_WEB_TASK_STACKSIZE
		int "Stacksize of the httpd task"
		range 3072 8192
		default 5120
		help
			Normal OTA functionality requires a higher stacksize than the default 4096, 5120 seems to work.

	config UCD_WEB_MAX_OPEN_SOCKETS
		int "Max number of sockets"
		range 4 32
		default 7
		help
			Max number of sockets/clients connected at any time
			(3 sockets are reserved for internal working of the HTTP server)

	config UCD_WEB_MAX_WS_FRAME_SIZE
		int "Max WebSocket frame size in bytes"
		range 128 131072
		default 4096
		help
			Maximum size of a WebSocket frame that can be received.

	config UCD_WEB_ENABLE_CORS
		bool "Enable CORS"
		default n
		help
			Sets Access-Control-Allow-Origin, Access-Control-Allow-Methods, Access-Control-Allow-Headers to *
		
endmenu
```

## main/Kconfig.projbuild
```kconfig
menu "UC Dock"
	config GPIO_RANGE_MAX
		int
		default 33 if IDF_TARGET_ESP32
		default 46 if IDF_TARGET_ESP32S2
		default 48 if IDF_TARGET_ESP32S3
		default 18 if IDF_TARGET_ESP32C2
		default 19 if IDF_TARGET_ESP32C3
		default 30 if IDF_TARGET_ESP32C6

	config UCD_EMBEDDED_MOUNT_POINT
		string "Embedded RO FS mount point in VFS"
		default "/ro"
		help
			Specify the mount point of the embedded read-only FrogFS in VFS.		

	config UCD_WEB_SERVER_PORT
		int "Web server port"
		range 1 65535
		default 80
		help
			The same port is used for REST and WebSockets

	config UCD_WEB_MOUNT_POINT
		string "Website mount point in VFS"
		default "/ro/webroot"
		help
			Specify the mount point in VFS.	

	config UCD_OTA_PSRAM_BUFSIZE
		int "OTA upload PSRAM buffer size"
		range 512 65536
		default 4096
		help
			OTA image upload buffer size for reading POST request. The buffer will be allocated in PSRAM.

	config UCD_OTA_UPLOAD_DELAY
		int "OTA upload task delay"
		range 0 100
		default 10
		help
			Task delay in ms after each OTA image upload buffer read. Use 0 to disable the delay.
			This allows lower priority tasks to run while the OTA image is being uploaded.

	config UCD_PORT_CHECK_BLASTER_ADC_THRESHOLD
		int "Port check voltage threshold in mV for IR-blasters"
		range 0 100
		default 10
		help
			ADC reading value threshold to consider peripheral to be an IR blaster.
			5V is switched on, GND path is switched off. There must be no short!
			The reading should be 0mV, but due to noise and ADC accuracy it might be a few millivolts.

	config UCD_PORT_CHECK_MONO_EMITTER_ADC_THRESHOLD_MIN
		int "Port check min voltage threshold in mV for mono IR-emitters"
		range 1900 2500
		default 2300
		help
			Minimal ADC reading value threshold to consider peripheral to be an old mono IR emitter.
			5V is switched on, GND path is switched off. There should be a short.
			The reading should be around 2570mV.
		
	config UCD_PORT_CHECK_MONO_EMITTER_ADC_THRESHOLD_MAX
		int "Port check max voltage threshold in mV for mono IR-emitters"
		range 2500 3100
		default 2900
		help
			Maximal ADC reading value threshold to consider peripheral to be an old mono IR emitter.
			5V is switched on, GND path is switched off. There should be a short.
			The reading should be around 2570mV.

	config UCD_CHARGER_PERIOD
		int "Charger monitor polling in ms"
		range 20 10000
		default 100
		help
			Polling interval in ms of the charger monitor.

	config UCD_CHARGER_LOG_INTERVAL
		int "Charger monitor logging interval in ms"
		range 300 60000
		default 10000
		help
			Logging interval in ms of the charger monitor. Logs the measured values.

	config UCD_CHARGER_STATE_MEASURE_COUNT
		int "Charger monitor state measure count"
		range 1 10
		default 3
		help
			Number of consecutive readings in the same voltage range to trigger a new charging state.
			Note that the overcurrent remeasure count is defined in UCD_CHARGER_OVERCURRENT_REMEASURE.
			This setting is only for charging <-> idle transitions.

	config UCD_CHARGER_OVERCURRENT_REMEASURE
		int "Charger monitor overcurrent measure count"
		range 0 10
		default 2
		help
			Number of remeasurements to detirme an overcurrent situation.
			An overcurrent detection will only be triggered if all readings detect an overcurrent.
			A single reading will not trigger it, except if the value is set to 0.

	config UCD_CHARGER_MAX_CURRENT_MA
		int "Maximum charging curent in mA"
		range 1000 2000 
		default 1500
		help
			Overcurrent protection to shut off charging.
		
	config UCD_CHARGER_ADC_THRESHOLD
		int "ADC idle reading threshold in mV"
		range 0 100 
		default 12
		help
			ADC reading value threshold to consider as not-charging.

	menu "BLE DeviceInfo configuration"
		config BLE_DEVICE_INFO_MANUFACTURER_NAME
			string "Manufacturer name"
			default "Unfolded Circle ApS"
		config BLE_DEVICE_NAME
			string "Device name"
			default "Dock 3"
	endmenu


endmenu
```

## sdkconfig.defaults
```kconfig
CONFIG_UCD_WEB_ENABLE_CORS=y

#
# ESP System Settings
#
# CONFIG_ESP_DEFAULT_CPU_FREQ_MHZ_80 is not set
# CONFIG_ESP_DEFAULT_CPU_FREQ_MHZ_160 is not set
CONFIG_ESP_DEFAULT_CPU_FREQ_MHZ_240=y
CONFIG_ESP_DEFAULT_CPU_FREQ_MHZ=240

CONFIG_ESP_TASK_WDT_PANIC=y

# default 2048 causes stack overflow and 3072 is still not enough. Likely because of timer usage in the state machines.
CONFIG_FREERTOS_TIMER_TASK_STACK_DEPTH=4092

# CONFIG_SPI_FLASH_HPM_ENA is not set
# CONFIG_SPI_FLASH_HPM_AUTO is not set
CONFIG_SPI_FLASH_HPM_DIS=y

#
# Security features
#
CONFIG_SECURE_SIGNED_ON_UPDATE=y
CONFIG_SECURE_SIGNED_APPS=y
CONFIG_SECURE_BOOT_V2_RSA_SUPPORTED=y
CONFIG_SECURE_BOOT_V2_PREFERRED=y
CONFIG_SECURE_SIGNED_APPS_NO_SECURE_BOOT=y
CONFIG_SECURE_SIGNED_APPS_RSA_SCHEME=y
CONFIG_SECURE_SIGNED_ON_UPDATE_NO_SECURE_BOOT=y
# CONFIG_SECURE_BOOT is not set
CONFIG_SECURE_BOOT_BUILD_SIGNED_BINARIES=y
CONFIG_SECURE_BOOT_SIGNING_KEY="ucd3_firmware_signing_key.pem"
# CONFIG_SECURE_FLASH_ENC_ENABLED is not set

#
# Compiler options
#
# Enable a mode for development to check stack:
# CONFIG_COMPILER_STACK_CHECK_MODE_NONE is not set
# CONFIG_COMPILER_STACK_CHECK_MODE_NORM=y
# CONFIG_COMPILER_STACK_CHECK_MODE_STRONG is not set
# CONFIG_COMPILER_STACK_CHECK_MODE_ALL is not set
# CONFIG_COMPILER_STACK_CHECK=y

# Override some defaults so BT stack is enabled
#
# BT config
#
CONFIG_BT_ENABLED=y
CONFIG_BT_BLUEDROID_ENABLED=n
CONFIG_BT_NIMBLE_ENABLED=y

#
# LWIP
#
CONFIG_LWIP_LOCAL_HOSTNAME="ucd3"
# CONFIG_LWIP_DNS_SUPPORT_MDNS_QUERIES is not set
CONFIG_LWIP_MAX_SOCKETS=16

#
# SNTP
#
CONFIG_LWIP_SNTP_MAX_SERVERS=2
CONFIG_LWIP_DHCP_GET_NTP_SRV=y
CONFIG_LWIP_DHCP_MAX_NTP_SERVERS=1
CONFIG_LWIP_SNTP_UPDATE_DELAY=3600000
CONFIG_LWIP_SNTP_STARTUP_DELAY=y
CONFIG_LWIP_SNTP_MAXIMUM_STARTUP_DELAY=5000
# end of SNTP

# Debug DHCP & SNTP internas:
#CONFIG_LWIP_DEBUG=y
#CONFIG_LWIP_DHCP_DEBUG=y
#CONFIG_LWIP_SNTP_DEBUG=y

CONFIG_HTTPD_WS_SUPPORT=y
CONFIG_HTTPD_MAX_REQ_HDR_LEN=1024

CONFIG_SPIFFS_OBJ_NAME_LEN=64
CONFIG_FATFS_LFN_HEAP=y

#
# Partition Table
#
# CONFIG_PARTITION_TABLE_SINGLE_APP is not set
# CONFIG_PARTITION_TABLE_SINGLE_APP_LARGE is not set
# CONFIG_PARTITION_TABLE_TWO_OTA is not set
CONFIG_PARTITION_TABLE_CUSTOM=y
CONFIG_PARTITION_TABLE_CUSTOM_FILENAME="partition_table/partitions.csv"
CONFIG_PARTITION_TABLE_FILENAME="partition_table/partitions.csv"
CONFIG_PARTITION_TABLE_OFFSET=0x8000
CONFIG_PARTITION_TABLE_MD5=y
# end of Partition Table

#
# Ethernet
#
CONFIG_ETH_ENABLED=y
CONFIG_ETH_USE_SPI_ETHERNET=y
CONFIG_ETH_SPI_ETHERNET_W5500=y

#
# mDNS
#
# Reduce memory consumption by disabling unused features and lowering resources
CONFIG_MDNS_MAX_SERVICES=5
# MDNS is only used to advertise services, so it should require less memory than the default 4096.
# 2048 leads to stack overflow, 3072 seems to work.
CONFIG_MDNS_TASK_STACK_SIZE=3072
# CONFIG_MDNS_ENABLE_CONSOLE_CLI is not set
# CONFIG_MDNS_PREDEF_NETIF_AP is not set

#
# LVGL
#
# Disable unused widgets to lower resource consumption

#
# Color settings
#
# CONFIG_LV_COLOR_DEPTH_32 is not set
# CONFIG_LV_COLOR_DEPTH_16 is not set
# CONFIG_LV_COLOR_DEPTH_8 is not set
CONFIG_LV_COLOR_DEPTH_1=y
CONFIG_LV_COLOR_DEPTH=1

#
# Enable built-in fonts
#
# CONFIG_LV_FONT_MONTSERRAT_8 is not set
# CONFIG_LV_FONT_MONTSERRAT_10 is not set
# CONFIG_LV_FONT_MONTSERRAT_12 is not set
CONFIG_LV_FONT_MONTSERRAT_14=y
CONFIG_LV_FONT_MONTSERRAT_16=y
CONFIG_LV_FONT_MONTSERRAT_18=y
# CONFIG_LV_FONT_MONTSERRAT_20 is not set
# CONFIG_LV_FONT_MONTSERRAT_22 is not set
# CONFIG_LV_FONT_MONTSERRAT_24 is not set
# CONFIG_LV_FONT_MONTSERRAT_26 is not set
# CONFIG_LV_FONT_MONTSERRAT_28 is not set
# CONFIG_LV_FONT_MONTSERRAT_30 is not set
CONFIG_LV_FONT_MONTSERRAT_32=y
# CONFIG_LV_FONT_MONTSERRAT_34 is not set
# CONFIG_LV_FONT_MONTSERRAT_36 is not set
# CONFIG_LV_FONT_MONTSERRAT_38 is not set
# CONFIG_LV_FONT_MONTSERRAT_40 is not set
# CONFIG_LV_FONT_MONTSERRAT_42 is not set
# CONFIG_LV_FONT_MONTSERRAT_44 is not set
# CONFIG_LV_FONT_MONTSERRAT_46 is not set
# CONFIG_LV_FONT_MONTSERRAT_48 is not set
# CONFIG_LV_FONT_MONTSERRAT_12_SUBPX is not set
# CONFIG_LV_FONT_MONTSERRAT_28_COMPRESSED is not set

#
# Widget usage
#
# CONFIG_LV_USE_ARC is not set
# CONFIG_LV_USE_BAR is not set
# CONFIG_LV_USE_BTN is not set
# CONFIG_LV_USE_BTNMATRIX is not set
# CONFIG_LV_USE_CANVAS is not set
# CONFIG_LV_USE_CHECKBOX is not set
# CONFIG_LV_USE_DROPDOWN is not set
CONFIG_LV_USE_IMG=y
CONFIG_LV_USE_LABEL=y
# CONFIG_LV_LABEL_TEXT_SELECTION is not set
CONFIG_LV_LABEL_LONG_TXT_HINT=y
# CONFIG_LV_USE_LINE is not set
# CONFIG_LV_USE_ROLLER is not set
# CONFIG_LV_USE_SLIDER is not set
# CONFIG_LV_USE_SWITCH is not set
# CONFIG_LV_USE_TEXTAREA is not set
# CONFIG_LV_USE_TABLE is not set
# end of Widget usage

#
# Extra Widgets
#
CONFIG_LV_USE_ANIMIMG=y
# CONFIG_LV_USE_CALENDAR is not set
# CONFIG_LV_USE_CHART is not set
# CONFIG_LV_USE_COLORWHEEL is not set
# CONFIG_LV_USE_IMGBTN is not set
# CONFIG_LV_USE_KEYBOARD is not set
# CONFIG_LV_USE_LED is not set
# CONFIG_LV_USE_LIST is not set
# CONFIG_LV_USE_MENU is not set
# CONFIG_LV_USE_METER is not set
# CONFIG_LV_USE_MSGBOX is not set
# CONFIG_LV_USE_SPAN is not set
# CONFIG_LV_SPAN_SNIPPET_STACK_SIZE is not set
# CONFIG_LV_USE_SPINBOX is not set
# CONFIG_LV_USE_SPINNER is not set
# CONFIG_LV_USE_TABVIEW is not set
# CONFIG_LV_USE_TILEVIEW is not set
# CONFIG_LV_USE_WIN is not set
# end of Extra Widgets

#
# Layouts
#
CONFIG_LV_USE_FLEX=y
# CONFIG_LV_USE_GRID is not set
# end of Layouts

#
# Others
#
# CONFIG_LV_USE_SNAPSHOT is not set
# CONFIG_LV_USE_MONKEY is not set
# CONFIG_LV_USE_GRIDNAV is not set
# CONFIG_LV_USE_FRAGMENT is not set
# CONFIG_LV_USE_IMGFONT is not set
# CONFIG_LV_USE_MSG is not set
# CONFIG_LV_USE_IME_PINYIN is not set
# end of Others

#
# Examples
#
# CONFIG_LV_BUILD_EXAMPLES is not set
# end of Examples
```
